## Documentation/devicetree/bindings/i2c/apple,i2c.yaml
```yaml
# SPDX-License-Identifier: (GPL-2.0 OR BSD-2-Clause)
%YAML 1.2
---
$id: "http://devicetree.org/schemas/i2c/apple,i2c.yaml#"
$schema: "http://devicetree.org/meta-schemas/core.yaml#"

title: Apple/PASemi I2C controller

maintainers:
  - Sven Peter <sven@svenpeter.dev>

allOf:
  - $ref: /schemas/i2c/i2c-controller.yaml#

properties:
  compatible:
    enum:
      - apple,t8103-i2c
      - apple,i2c

  reg:
    maxItems: 1

  clocks:
    minItems: 2
    items:
      - description: Clock gating the controller itself
      - description: I2C bus reference clock

  clock-names:
    minItems: 2
    items:
      - const: gate
      - const: ref

  interrupts:
    maxItems: 1

  clock-frequency:
    minimum: 1
    maximum: 400000
    description: |
      Desired operating frequency of the bus in Hz. Defaults to 100 KHz.

required:
  - compatible
  - reg
  - clocks
  - clock-names
  - interrupts

unevaluatedProperties: false

examples:
  - |
    i2c@a110000 {
      compatible = "apple,t8103-i2c";
      reg = <0x35010000 0x4000>;
      interrupt-parent = <&aic>;
      interrupts = <0 627 4>;
      clocks = <&gate_clk>, <&ref_clk>;
      clock-names = "gate", "ref";
      #address-cells = <1>;
      #size-cells = <0>;
    };
```

## Documentation/devicetree/bindings/interrupt-controller/msi-controller.yaml
```yaml
# SPDX-License-Identifier: BSD-2-Clause
%YAML 1.2
---
$id: http://devicetree.org/schemas/interrupt-controller/msi-controller.yaml#
$schema: http://devicetree.org/meta-schemas/core.yaml#

title: MSI controller

maintainers:
  - Marc Zyngier <marc.zyngier@arm.com>

description: |
  An MSI controller signals interrupts to a CPU when a write is made
  to an MMIO address by some master. An MSI controller may feature a
  number of doorbells.

properties:
  "#msi-cells":
    description: |
      The number of cells in an msi-specifier, required if not zero.

      Typically this will encode information related to sideband data,
      and will not encode doorbells or payloads as these can be
      configured dynamically.

      The meaning of the msi-specifier is defined by the device tree
      binding of the specific MSI controller.

  msi-controller:
    description:
      Identifies the node as an MSI controller.
    $ref: /schemas/types.yaml#/definitions/flag

  msi-ranges:
    description:
      A list of pairs <intid span>, where "intid" is the specification
      of the first interrupt (including the phandle for the interrupt
      controller) that can be used as an MSI, and "span" the size of
      that range. Multiple ranges can be provided.
    $ref: /schemas/types.yaml#/definitions/phandle-array

additionalProperties: true
```

## drivers/gpu/drm/apple/Kconfig
```kconfig
# SPDX-License-Identifier: GPL-2.0-only
config DRM_APPLE
	tristate "DRM Support for Apple display controllers"
	depends on DRM && OF && ARM64
	depends on ARCH_APPLE || COMPILE_TEST
	select DRM_KMS_HELPER
	select DRM_KMS_CMA_HELPER
	select DRM_GEM_CMA_HELPER
	select VIDEOMODE_HELPERS
	help
	  Say Y if you have an Apple Silicon chipset.
```
